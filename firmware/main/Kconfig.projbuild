## rebuild/firmware/components/sensor_service/Kconfig
```kconfig
menu "Sensor readings"

    config BB_PH_DEFAULT
        int "Default pH multiplied by 100"
        range 0 1400
        default 780
        help
            Fixed default, not a physical measurement or a calibrated estimate.

endmenu
```

## rebuild/firmware/components/telemetry/Kconfig.projbuild
```kconfig
menu "Bangus Buhai telemetry"
config BB_TELEMETRY_BINDING_ID
    string "Test binding UUID (not production enrollment)"
    default "97fcde45-4112-41d4-a509-17e5bb1c0d91"
    help
        Explicit local T08 test binding. Actual tank assignment/enrollment is
        outside T08. Existing queued events retain their original binding.
endmenu
```

## rebuild/firmware/main/Kconfig.projbuild
```kconfig
menu "Bangus Buhai"

    config BB_GPIO_DS18B20
        int "DS18B20 data GPIO"
        default 2
        help
            GPIO connected to the DS18B20 data line.
            The prototype uses D1 / GPIO 2 on the XIAO ESP32-S3.

    config BB_GPIO_TURBIDITY
        int "Turbidity sensor ADC GPIO"
        default 1
        help
            GPIO connected to the turbidity sensor analog output.
            The prototype uses D0 / GPIO 1 on the XIAO ESP32-S3.

    config BB_GPIO_RELAY
        int "Active-low demo relay GPIO"
        range 0 48
        default 3

    config BB_GPIO_I2C_SDA
        int "LCD SDA GPIO"
        range 0 48
        default 4

    config BB_GPIO_I2C_SCL
        int "LCD SCL GPIO"
        range 0 48
        default 5

    config BB_LCD_I2C_ADDRESS
        hex "LCD I2C address"
        range 0x08 0x77
        default 0x27

endmenu
```

## rebuild/firmware/tests/sdkconfig.defaults
```kconfig
CONFIG_UNITY_ENABLE_64BIT=y
CONFIG_ESP_MAIN_TASK_STACK_SIZE=12288
CONFIG_ESPTOOLPY_FLASHSIZE_8MB=y
```
